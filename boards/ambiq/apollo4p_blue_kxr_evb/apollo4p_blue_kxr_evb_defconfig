## boards/ambiq/apollo4p_blue_kxr_evb/apollo4p_blue_kxr_evb_defconfig
```kconfig
# SPDX-License-Identifier: Apache-2.0
#
# Copyright (c) 2023 Ambiq Micro Inc. <www.ambiq.com>

CONFIG_CONSOLE=n
CONFIG_UART_CONSOLE=n
CONFIG_SERIAL=y
CONFIG_UART_INTERRUPT_DRIVEN=y

# Use SWO for log prints by default.
CONFIG_PINCTRL=y
CONFIG_LOG=y
CONFIG_LOG_BACKEND_SWO=y
CONFIG_LOG_BUFFER_SIZE=1024
CONFIG_LOG_PRINTK=y
CONFIG_LOG_MODE_DEFERRED=y
```

## boards/ambiq/apollo4p_evb/Kconfig.defconfig
```kconfig
# SPDX-License-Identifier: Apache-2.0
#
# Copyright (c) 2023 Ambiq Micro Inc. <www.ambiq.com>

if BOARD_APOLLO4P_EVB

if LOG_BACKEND_SWO

config LOG_BACKEND_SWO_FREQ_HZ
    default 1000000

endif # LOG_BACKEND_SWO

endif # BOARD_APOLLO4P_EVB
```

## boards/ambiq/apollo4p_evb/apollo4p_evb_defconfig
```kconfig
# SPDX-License-Identifier: Apache-2.0
#
# Copyright (c) 2023 Antmicro <www.antmicro.com>

CONFIG_CONSOLE=n
CONFIG_UART_CONSOLE=n
CONFIG_SERIAL=n
CONFIG_UART_INTERRUPT_DRIVEN=n
```

## boards/ambiq/apollo4p_stmobo2/Kconfig.apollo4p_stmobo2
```kconfig
# SPDX-License-Identifier: Apache-2.0
#
# Copyright (c) 2023 Antmicro <www.antmicro.com>

config BOARD_APOLLO4P_STMOBO2
	select SOC_APOLLO4P
```

## boards/arm/apollo3_evb/Kconfig.board
```kconfig
# SPDX-License-Identifier: Apache-2.0
#
# Copyright (c) 2023 Ambiq Micro Inc. <www.ambiq.com>

config BOARD_APOLLO3_EVB
	bool "Ambiq Apollo3 Blue Evaluation Board"
	depends on SOC_APOLLO3_BLUE
```

## boards/arm/apollo3_evb/Kconfig.defconfig
```kconfig
# SPDX-License-Identifier: Apache-2.0
#
# Copyright (c) 2023 Ambiq Micro Inc. <www.ambiq.com>

config BOARD
	default "apollo3_evb"
	depends on BOARD_APOLLO3_EVB

config SYS_CLOCK_TICKS_PER_SEC
	default 1024

config PM_DEVICE
	default y if PM

config PM_DEVICE_RUNTIME
	default y if PM
```

## boards/arm/apollo3p_evb/Kconfig.board
```kconfig
# SPDX-License-Identifier: Apache-2.0
#
# Copyright (c) 2023 Ambiq Micro Inc. <www.ambiq.com>

config BOARD_APOLLO3P_EVB
	bool "Ambiq Apollo3 Blue Plus Evaluation Board"
	depends on SOC_APOLLO3P_BLUE
```

## boards/arm/apollo3p_evb/Kconfig.defconfig
```kconfig
# SPDX-License-Identifier: Apache-2.0
#
# Copyright (c) 2023 Ambiq Micro Inc. <www.ambiq.com>

config BOARD
	default "apollo3p_evb"
	depends on BOARD_APOLLO3P_EVB

config SYS_CLOCK_TICKS_PER_SEC
	default 1024
```

## boards/arm/apollo4p_blue_kxr_evb/apollo4p_blue_kxr_evb_defconfig
```kconfig
# SPDX-License-Identifier: Apache-2.0
#
# Copyright (c) 2023 Ambiq Micro Inc. <www.ambiq.com>

CONFIG_SOC_SERIES_APOLLO4X=y
CONFIG_SOC_APOLLO4P_BLUE=y
CONFIG_CONSOLE=y
CONFIG_UART_CONSOLE=y
CONFIG_SERIAL=y
CONFIG_UART_INTERRUPT_DRIVEN=y
CONFIG_USE_SEGGER_RTT=y
CONFIG_UART_RTT=y
CONFIG_RTT_CONSOLE=y
CONFIG_UART_ASYNC_API=y
```

## boards/shields/apollo3p_evb_disp_shield/Kconfig.shield
```kconfig
# Copyright (c) 2023 Ambiq <www.ambiq.com>
# SPDX-License-Identifier: Apache-2.0
config SHIELD_APOLLO3P_EVB_DISP_SHIELD
	def_bool $(shields_list_contains,apollo3p_evb_disp_shield)
```

## drivers/display/Kconfig.ambiq_rm69330
```kconfig
# Copyright 2023, NXP
# SPDX-License-Identifier: Apache-2.0

config AMBIQ_RM69330
	bool "AMBIQ RM69330 display driver"
	default y
	select AMBIQ_HAL
	depends on DT_HAS_AMBIQ_RM69330_ENABLED
	help
	  Enable driver for RM69330 display driver.
```

## drivers/flash/Kconfig.mspi
```kconfig
# Copyright (c) 2024 Ambiq Micro Inc. <www.ambiq.com>
# SPDX-License-Identifier: Apache-2.0

menu "MSPI flash device driver"

config FLASH_MSPI
	bool
	select FLASH_HAS_DRIVER_ENABLED
	select MSPI
	help
	  MSPI flash drivers are enabled.

config FLASH_MSPI_EMUL_DEVICE
	bool "MSPI flash device emulator"
	default y
	depends on DT_HAS_ZEPHYR_MSPI_EMUL_FLASH_ENABLED
	select FLASH_MSPI
	select FLASH_HAS_PAGE_LAYOUT
	select FLASH_HAS_EXPLICIT_ERASE

config FLASH_MSPI_ATXP032
	bool "MSPI ATXP032 driver"
	default y
	depends on DT_HAS_MSPI_ATXP032_ENABLED
	select FLASH_MSPI
	select FLASH_HAS_PAGE_LAYOUT
	select FLASH_HAS_EXPLICIT_ERASE
	select FLASH_JESD216
	select MSPI_AMBIQ_AP3 if SOC_SERIES_APOLLO3X

config FLASH_MSPI_NOR
	bool "MSPI NOR Flash"
	default y
	depends on DT_HAS_JEDEC_MSPI_NOR_ENABLED
	select FLASH_MSPI
	select FLASH_HAS_EXPLICIT_ERASE
	select FLASH_HAS_PAGE_LAYOUT
	select FLASH_JESD216
	select FLASH_HAS_EX_OP
	select MSPI_AMBIQ_AP3 if SOC_SERIES_APOLLO3X

endmenu

if FLASH_MSPI_NOR

choice MSPI_NOR_SFDP
	prompt "Source for Serial Flash Discoverable Parameters"
	default MSPI_NOR_SFDP_MINIMAL

config MSPI_NOR_SFDP_MINIMAL
	bool "Fixed flash configuration"
	help
	  Synthesize a minimal configuration assuming 256 By page size (or as
	  set by the page-size devicetree property) and
	  standard 4 KiBy and 64 KiBy erase instructions.  Requires the size and
	  jedec-id properties in the devicetree jedec,spi-nor node.

config MSPI_NOR_SFDP_DEVICETREE
	bool "Basic Flash Parameters from devicetree node"
	help
	  The JESD216 Basic Flash Parameters table must be provided in the
	  sfdp-bfp property in devicetree.  The size and jedec-id properties are
	  also required.

config MSPI_NOR_SFDP_RUNTIME
	bool "Read flash parameters at runtime"
	help
	  Read all flash device characteristics from the device at runtime.
	  This option is the most flexible as it should provide functionality
	  for all supported JESD216-compatible devices.

endchoice

config MSPI_NOR_CS_WAIT_DELAY
	int "Delay time in us"
	default 0
	help
	  This is the wait delay (in us) to allow for CS switching to take effect

config MSPI_NOR_SLEEP_WHILE_WAITING_UNTIL_READY
	bool "Sleep while waiting for flash operations to complete"
	default y
	help
	  Flash operations can take anywhere from 1ms to 240 seconds to
	  complete. Enabling this option adds a delay between polls on the
	  status register for slow operations. Disabling this option can
	  result in significant flash savings if this driver is the only user
	  of "k_sleep". This can be the case when building as a bootloader.

config MSPI_NOR_FLASH_LAYOUT_PAGE_SIZE
	int "Page size to use for FLASH_LAYOUT feature"
	default 65536
	help
	  When CONFIG_FLASH_PAGE_LAYOUT is used this driver will support
	  that API.  By default the page size corresponds to the block
	  size (65536).  Other options include the 32K-byte erase size
	  (32768), the sector size (4096), or any non-zero multiple of the
	  sector size.

config MSPI_NOR_IDLE_IN_DPD
	bool "Use Deep Power-Down mode when flash is not being accessed."
	help
	  Where supported deep power-down mode can reduce current draw
	  to as little as 0.1% of standby current.  However it takes
	  some milliseconds to enter and exit from this mode.

	  Select this option for applications where device power
	  management is not enabled, the flash remains inactive for
	  long periods, and when used the impact of waiting for mode
	  enter and exit delays is acceptable.

endif # FLASH_MSPI_NOR
```

## drivers/gpio/Kconfig.apollo3
```kconfig
# Ambiq SDK GPIO
#
# Copyright (c) 2023 Antmicro <www.antmicro.com>
#
# SPDX-License-Identifier: Apache-2.0
#

config GPIO_AMBIQ_APOLLO3
	bool "AMBIQ APOLLO3 GPIO driver"
	default y
	depends on DT_HAS_AMBIQ_APOLLO3_GPIO_ENABLED
	select AMBIQ_HAL
	help
	  Enable driver for Ambiq Apollo3 gpio.
```

## drivers/gpio/Kconfig.apollo4
```kconfig
# Ambiq SDK GPIO
#
# Copyright (c) 2023 Antmicro <www.antmicro.com>
#
# SPDX-License-Identifier: Apache-2.0
#

config GPIO_AMBIQ_APOLLO4
	bool "AMBIQ APOLLO4 GPIO driver"
	default y
	depends on DT_HAS_AMBIQ_APOLLO4_GPIO_ENABLED
	select AMBIQ_HAL
	help
	  Enable driver for Ambiq Apollo4 gpio.
```

## drivers/i2s/Kconfig.ambiq
```kconfig
# Ambiq I2S driver configuration options

# Copyright (c) 2024 Ambiq
# SPDX-License-Identifier: Apache-2.0

config I2S_AMBIQ
	bool "AMBIQ I2S driver"
	default y
	depends on DT_HAS_AMBIQ_I2S_ENABLED
	select AMBIQ_HAL
	select AMBIQ_HAL_USE_I2S
	help
	  Enable I2S support on the Ambiq family of processors.
	  (Tested on the Apollo4 Plus & Apollo4 Blue Plus series)

if I2S_AMBIQ

config I2S_AMBIQ_RX_BLOCK_COUNT
	int "RX queue length"
	default 256

config I2S_AMBIQ_TX_BLOCK_COUNT
	int "TX queue length"
	default 256

endif # I2S_AMBIQ
```

## drivers/memc/Kconfig.ambiq
```kconfig
# Copyright (c) 2024, Ambiq Micro Inc. <www.ambiq.com>
# SPDX-License-Identifier: Apache-2.0

config MEMC_MSPI_APS6404L
	bool "MSPI AP Memory APS6404L pSRAM driver"
	default y
	depends on DT_HAS_MSPI_APS6404L_ENABLED
	select GPIO
	select MSPI
	select MSPI_AMBIQ_AP3 if SOC_SERIES_APOLLO3X
	select MSPI_AMBIQ_AP4 if SOC_SERIES_APOLLO4X
```

## drivers/mspi/Kconfig.ambiq
```kconfig
# Copyright (c) 2024, Ambiq Micro Inc. <www.ambiq.com>
# SPDX-License-Identifier: Apache-2.0

config MSPI_AMBIQ_AP3
	bool "Ambiq Apollo3 series MSPI driver"
	default n
	depends on DT_HAS_AMBIQ_MSPI_CONTROLLER_ENABLED
	select AMBIQ_HAL
	select AMBIQ_HAL_USE_MSPI
	select MSPI_XIP
	select MSPI_SCRAMBLE
	select MSPI_TIMING
	help
	  Enable driver for Ambiq MSPI.

config MSPI_AMBIQ_AP4
	bool "Ambiq Apollo4 Plus series MSPI driver"
	default n
	depends on DT_HAS_AMBIQ_MSPI_CONTROLLER_ENABLED
	select AMBIQ_HAL
	select AMBIQ_HAL_USE_MSPI
	select MSPI_XIP
	select MSPI_SCRAMBLE
	select MSPI_TIMING
	help
	  Enable driver for Ambiq MSPI.

DT_CHOSEN_Z_SRAM := zephyr,sram

config MSPI_BUFF_RAM_LOCATION
	hex "byte offset to SRAM_BASE_ADDRESS"
	default 0x50000
	help
	  This option specifies the mspi buffer/heap start address
```

## drivers/spi/Kconfig.ambiq
```kconfig
# Ambiq SDK SPI
#
# Copyright (c) 2023 Antmicro <www.antmicro.com>
#
# SPDX-License-Identifier: Apache-2.0
#

config SPI_AMBIQ
	bool "AMBIQ SPI driver"
	default y
	depends on DT_HAS_AMBIQ_SPI_ENABLED
	select AMBIQ_HAL
	select AMBIQ_HAL_USE_SPI
	help
	  Enable driver for Ambiq SPI.

config SPI_AMBIQ_DMA
    bool "AMBIQ APOLLO SPI DMA Support"
	help
	  Enable DMA for Ambiq SPI.

config SPI_DMA_TCB_BUFFER_SIZE
	int "DMA Transfer Control Buffer size in words."
	default 1024
	help
	  DMA Transfer Control Buffer size in words

config MSPI_AMBIQ
	bool "AMBIQ MSPI driver"
	default y
	depends on DT_HAS_AMBIQ_MSPI_ENABLED
	select AMBIQ_HAL
	select AMBIQ_HAL_USE_MSPI
	help
	  Enable driver for Ambiq MSPI.
```

## dts/bindings/adc/ambiq,adc.yaml
```yaml
# Copyright (c) 2024 Ambiq Micro Inc.
# SPDX-License-Identifier: Apache-2.0

description: Ambiq ADC node

compatible: "ambiq,adc"

include: [adc-controller.yaml, pinctrl-device.yaml, ambiq-pwrcfg.yaml]
properties:
  reg:
    required: true

#   interrupts:
#     required: true

  "#io-channel-cells":
    const: 1

io-channel-cells:
  - input
```

## dts/bindings/display/ambiq,rm69330.yaml
```yaml
#
# Copyright 2023, NXP
#
# SPDX-License-Identifier: Apache-2.0
#

description: Ambiq Raydium RM69330 Panel

compatible: "ambiq,rm69330"

include: [display-controller.yaml, pinctrl-device.yaml]

properties:

  interrupts:
    required: true

  reset-gpios:
    type: phandle-array
    description: |
      The RESETn pin is asserted to disable the sensor causing a hard
      reset.  The sensor receives this as an active-low signal.

  te-gpios:
    type: phandle-array
    description: |
      The tearing effect pin is asserted by the controller at a display
      VSYNC interval. This permits the controller to send new display
      data during a VSYNC interval, removing tearing.

  bl-gpios:
    type: phandle-array
    description: |
      The BLn pin is asserted to control the backlight of the panel.
      The sensor receives this as an active-high signal.

  pixel-format:
    type: int
    required: true
    description:
      Pixel format. Available formats in dt-bindings/mipi_dsi/mipi_dsi.h.
```

## dts/bindings/gpio/ambiq,apollo3-gpio-bank.yaml
```yaml
# Copyright (c) 2023 Antmicro <www.antmicro.com>
# Copyright (c) 2023 Ambiq Micro Inc. <www.ambiq.com>
# SPDX-License-Identifier: Apache-2.0

description: Ambiq Apollo3 GPIO bank node

compatible: "ambiq,apollo3-gpio-bank"

include: [gpio-controller.yaml, base.yaml]

properties:
  reg:
    required: true
    description: |
      This property indicates the register address offset of each GPIO child node
      under the "ambiq,apollo3-gpio" parent node. The register address of pin described in
      gpio-cells can be obtained by: base address + child address offset + pin.

  "#gpio-cells":
    const: 2

gpio-cells:
  - pin
  - flags
```

## dts/bindings/gpio/ambiq,apollo3-gpio.yaml
```yaml
# Copyright (c) 2023 Ambiq Micro Inc. <www.ambiq.com>
# SPDX-License-Identifier: Apache-2.0

description: |
    Ambiq Apollo3 GPIO provides the GPIO pin mapping for GPIO child nodes.

    The Ambiq Apollo3x soc designs a single GPIO port with 74 pins.
    It uses 74 continuous 32-bit registers to configure the GPIO pins.
    This binding provides a pin mapping to solve the limitation of the maximum
    32 pins handling in GPIO driver API.

    The Ambiq Apollo3x soc should define one "ambiq,apollo3-gpio" parent node in soc
    devicetree and some child nodes which are compatible with "ambiq,apollo3-gpio-bank"
    under this parent node.

    Here is an example of how a "ambiq,apollo3-gpio" node can be used with the combined
    gpio child nodes:

    pinctrl: pin-controller@40010000 {
      compatible = "ambiq,apollo3-pinctrl";
      reg = <0x40010000 0x800>;
      #address-cells = <1>;
      #size-cells = <0>;

      gpio: gpio@40010000 {
        compatible = "ambiq,apollo3-gpio";
        gpio-map-mask = <0xffffffe0 0xffffffc0>;
        gpio-map-pass-thru = <0x1f 0x3f>;
        gpio-map = <
          0x00 0x0 &gpio0_31 0x0 0x0
          0x20 0x0 &gpio32_63 0x0 0x0
          0x40 0x0 &gpio64_95 0x0 0x0
        >;
        reg = <0x40010000>;
        #gpio-cells = <2>;
        #address-cells = <1>;
        #size-cells = <0>;
        ranges;

        gpio0_31: gpio0_31@0 {
          compatible = "ambiq,apollo3-gpio-bank";
          gpio-controller;
          #gpio-cells = <2>;
          reg = <0>;
          interrupts = <13 0>;
          status = "disabled";
        };

        gpio32_63: gpio32_63@20 {
          compatible = "ambiq,apollo3-gpio-bank";
          gpio-controller;
          #gpio-cells = <2>;
          reg = <0x20>;
          interrupts = <13 0>;
          status = "disabled";
        };

        gpio64_95: gpio64_95@40 {
          compatible = "ambiq,apollo3-gpio-bank";
          gpio-controller;
          #gpio-cells = <2>;
          reg = <0x40>;
          interrupts = <13 0>;
          status = "disabled";
          ngpios = <10>;
        };
    };

    In the above example, the gpio@40010000 is a "ambiq,apollo3-gpio" parent node which
    provides the base register address 0x40010000. It has three "ambiq,apollo3-gpio-bank"
    child nodes. Two of them cover 32 pins (the default value of "ngpios" property is 32)
    and the other one covers 10 pins. The "reg" property of child nodes defines the register
    address offset. The register address of pin described in gpio-cells can be obtained by: 
    base address + child address offset + pin. For example: the address of pin 20 of 
    gpio32_63@20 node is (0x40010000 + 0x20 + 20) = 0x40010034 and the real GPIO pin number
    of this pin in soc is (20 + 32) = 52.

compatible: "ambiq,apollo3-gpio"

include: [gpio-nexus.yaml, base.yaml]
```

## dts/bindings/gpio/ambiq,apollo4-gpio-bank.yaml
```yaml
# Copyright (c) 2023 Antmicro <www.antmicro.com>
# Copyright (c) 2023 Ambiq Micro Inc. <www.ambiq.com>
# SPDX-License-Identifier: Apache-2.0

description: Ambiq Apollo4 GPIO bank node

compatible: "ambiq,apollo4-gpio-bank"

include: [gpio-controller.yaml, base.yaml]

properties:
  reg:
    required: true
    description: |
      This property indicates the register address offset of each GPIO child node
      under the "ambiq,apollo4-gpio" parent node. The register address of pin described in
      gpio-cells can be obtained by: base address + child address offset + (pin << 2).

  "#gpio-cells":
    const: 2

gpio-cells:
  - pin
  - flags
```
