/*
 * Copyright (c) 2023 Ambiq Micro Inc.
 *
 * SPDX-License-Identifier: Apache-2.0
 */

/ {
	resources {
		compatible = "test-gpio-basic-api";
		out-gpios = <&ambiq_header 14 0>; /* GPIO14 */
		in-gpios = <&ambiq_header 13 0>;  /* GPIO13 */
	};
};
