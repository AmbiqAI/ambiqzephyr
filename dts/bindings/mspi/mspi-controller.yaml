## dts/bindings/mspi/mspi-controller.yaml
```yaml
# Copyright (c) 2024, Ambiq Micro Inc. <www.ambiq.com>
# SPDX-License-Identifier: Apache-2.0

# Common fields for MSPI controllers

include: base.yaml

bus: mspi

properties:
  clock-frequency:
    type: int
    description: |
      Clock frequency the MSPI peripheral is being driven at, in Hz.
  "#address-cells":
    required: true
    const: 1
  "#size-cells":
    required: true
    const: 0

  op-mode:
    type: string
    enum:
      - "MSPI_MASTER"
      - "MSPI_SLAVE"
    description: |
      Indicate MSPI master or slave mode of the controller.
      The controller driver may use this during initialization.

  duplex:
    type: string
    enum:
      - "MSPI_HALF_DUPLEX"
      - "MSPI_FULL_DUPLEX"
    description: |
      Indicate MSPI Duplex mode, full or half.
      The controller driver may check this setting against its
      capabilities.

  dqs-support:
    type: boolean
    description: |
      Indicate whether the hardware supports DQS.
      The controller driver may check this setting against its
      capabilities.

  ce-gpios:
    type: phandle-array
    description: |
      An array of chip select GPIOs to use. Each element
      in the array specifies a GPIO. The index in the array
      corresponds to the child node that the CE gpio controls.

      Example:

        mspi@... {
                ce-gpios = <&gpio0 23 GPIO_ACTIVE_LOW>,
                              <&gpio1 10 GPIO_ACTIVE_LOW>,
                              ...;

                mspi-device@0 {
                        reg = <0>;
                        ...
                };
                mspi-device@1 {
                        reg = <1>;
                        ...
                };
                ...
        };

      The child node "mspi-device@0" specifies a mspi device with
      chip select controller gpio0, pin 23, and devicetree
      GPIO flags GPIO_ACTIVE_LOW. Similarly, "mspi-device@1" has CE GPIO
      controller gpio1, pin 10, and flags GPIO_ACTIVE_LOW. Additional
      devices can be configured in the same way.

      If unsure about the flags cell, GPIO_ACTIVE_LOW is generally a safe
      choice for a typical "CEn" pin. GPIO_ACTIVE_HIGH may be used if
      intervening hardware inverts the signal to the peripheral device or
      the line itself is active high.

      Regardless of whether the CE pin may need software control or MSPI
      controller has dedicated CE pin, this field should be defined to
      help manage multiple devices on the same MSPI controller.
```

## dts/bindings/mspi/mspi-device.yaml
```yaml
# Copyright (c) 2024, Ambiq Micro Inc. <www.ambiq.com>
# SPDX-License-Identifier: Apache-2.0

# Common fields for MSPI devices

include: [base.yaml, power.yaml]

on-bus: mspi

properties:
  reg:
    required: true

  mspi-max-frequency:
    type: int
    required: true
    description: |
      Maximum clock frequency of device to configure in Hz.
      In device tree, it is normally the target operating
      frequency after initialization.

  mspi-io-mode:
    type: string
    enum:
      - "MSPI_IO_MODE_SINGLE"
      - "MSPI_IO_MODE_DUAL"
      - "MSPI_IO_MODE_DUAL_1_1_2"
      - "MSPI_IO_MODE_DUAL_1_2_2"
      - "MSPI_IO_MODE_QUAD"
      - "MSPI_IO_MODE_QUAD_1_1_4"
      - "MSPI_IO_MODE_QUAD_1_4_4"
      - "MSPI_IO_MODE_OCTAL"
      - "MSPI_IO_MODE_OCTAL_1_1_8"
      - "MSPI_IO_MODE_OCTAL_1_8_8"
      - "MSPI_IO_MODE_HEX"
    description: |
      MSPI I/O mode setting.
      In device tree, it is normally the target io mode
      after initialization.

  mspi-data-rate:
    type: string
    enum:
      - "MSPI_SINGLE_DATA_RATE"
      - "MSPI_DUAL_DATA_RATE"
    description:
      MSPI data rate setting.
      In device tree, it is normally the target data rate
      after initialization.

  mspi-hardware-ce-num:
    type: int
    description: |
      MSPI hardware CE number.
      MSPI controller may natively support multiple slave devices
      on the same MSPI instance by assigning designated CE numbers.

  mspi-cpp-mode:
    type: string
    enum:
      - "MSPI_CPP_MODE_0"
      - "MSPI_CPP_MODE_1"
      - "MSPI_CPP_MODE_2"
      - "MSPI_CPP_MODE_3"
    description: |
      MSPI clock polarity setting.
      MSPI_CPP_MODE_0: CPOL=0, CPHA=0
      MSPI_CPP_MODE_1: CPOL=0, CPHA=1
      MSPI_CPP_MODE_2: CPOL=1, CPHA=0
      MSPI_CPP_MODE_3: CPOL=1, CPHA=1

  mspi-endian:
    type: string
    enum:
      - "MSPI_LITTLE_ENDIAN"
      - "MSPI_BIG_ENDIAN"
    description: |
      MSPI transfer MSB or LSB first.

  mspi-ce-polarity:
    type: string
    enum:
      - "MSPI_CE_ACTIVE_LOW"
      - "MSPI_CE_ACTIVE_HIGH"
    description: |
      MSPI CE polarity. In most cases, it is active low.

  mspi-dqs-enable:
    type: boolean
    description: |
      Enable DQS mode for a device which supports it.
      This will be checked against dqs-support and configure
      the MSPI hardware if it supports DQS mode.

  mspi-hold-ce:
    type: boolean
    description: |
      In some cases, it is necessary for the master to manage
      MSPI chip enable (under software control), so that multiple
      mspi transactions can be performed without releasing CE.
      A typical use case is variable length MSPI packets where
      the first mspi transaction reads the length and the second
      mspi transaction reads length bytes.

  rx-dummy:
    type: int
    description: |
      The number of data or clock cycles between addr and data
      in RX direction.
      0 means the RX dummy phase is disabled.

  tx-dummy:
    type: int
    description: |
      The number of data or clock cycles between addr and data
      in TX direction.
      0 means the TX dummy phase is disabled.

  read-instruction:
    type: int
    description: |
      Read command to be sent in RX direction.

  write-instruction:
    type: int
    description: |
      Write command to be sent in RX direction.

  instruction-length:
    type: string
    enum:
      - "INSTR_DISABLED"
      - "INSTR_1_BYTE"
      - "INSTR_2_BYTE"
    description: |
      Length in bytes of the write and read instructions.

  address-length:
    type: string
    enum:
      - "ADDR_DISABLED"
      - "ADDR_1_BYTE"
      - "ADDR_2_BYTE"
      - "ADDR_3_BYTE"
      - "ADDR_4_BYTE"
    description: |
      Length in bytes of address to be sent in address phase.

  xip-config:
    type: array
    description: |
      Array of parameters to configure the xip feature.
      bEnable: whether XIP feature is enabled.
      ui32AddOffset: The offset in bytes to the start of the
                     platform specific XIP address region.
      ui32Size: The size in bytes of the XIP address region one
                wish to enable or disable.
      ePermission: The permission granted to the region. (RW/RO)

      For controller that support this feature. One may map the device
      memory into Soc system memory map. i.e. XIP address region
      So that the device may be used as an external RAM and execute code.

      default =
      <
        .bEnable        = false;
        .ui32AddOffset  = 0;
        .ui32Size       = 0;
        .ePermission    = 0;
      >

  scramble-config:
    type: array
    description: |
      Array of parameters to configure the scrambling feature.
      bEnable: whether scrambling feature is enabled.
      ui32AddOffset: The offset in bytes to the start address which
                     can be the offset to the start of the platform
                     specific XIP address region or phyiscal device address.

      ui32Size: The size in bytes of the region one wish to enable or disable.
      For controller that support hardware scrambling, one may use it for
      additional security to protect data or code stored in external devices.

      default =
      <
        .bEnable        = false;
        .ui32AddOffset  = 0;
        .ui32Size       = 0;
      >

  ce-break-config:
    type: array
    description: |
      Array of parameters to configure the auto CE break feature.
      ui32MemBoundary: Memory boundary in bytes of a device that a transfer
                       should't cross.
      ui32BreakTimeLimit: The maximum time of a transfer should't exceed for
                          a device in micro seconds.

      This is typically used with devices that has memory boundaries or
      requires periodic internal refresh. e.g. psram

      default =
      <
        .ui32MemBoundary      = 0;
        .ui32BreakTimeLimit   = 0;
      >
```
