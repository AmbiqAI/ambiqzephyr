## dts/bindings/mtd/jedec,mspi-nor.yaml
```yaml
# Copyright (c) 2024, Ambiq Micro Inc. <www.ambiq.com>
# SPDX-License-Identifier: Apache-2.0

description: |
  Properties supporting Zephyr mspi-nor flash driver (over the Zephyr MSPI
  API) control of serial flash memories using the standard M25P80-based
  command set.

compatible: "jedec,mspi-nor"

include: [mspi-device.yaml, "jedec,jesd216F.yaml"]

properties:
  wp-gpios:
    type: phandle-array
    description: WPn pin
  hold-gpios:
    type: phandle-array
    description: HOLDn pin
  reset-gpios:
    type: phandle-array
    description: RESETn pin

  has-dpd:
    type: boolean
    description: |
      Indicates the device supports the DPD (0xB9) command.

      Use this property to indicate the flash chip supports the Deep
      Power-Down mode that is entered by command 0xB9 to reduce power
      consumption below normal standby levels.  Use of this property
      implies that the RDPD (0xAB) Release from Deep Power Down command
      is also supported.  (On some chips this command functions as Read
      Electronic Signature; see t-enter-dpd).

  dpd-wakeup-sequence:
    type: array
    description: |
      Specifies wakeup durations for devices without RDPD.

      Some devices (Macronix MX25R in particular) wake from deep power
      down by a timed sequence of CSn toggles rather than the RDPD
      command.  This property specifies three durations measured in
      nanoseconds, in this order:
      (1) tDPDD (Delay Time for Release from Deep Power-Down Mode)
      (2) tCDRP (CSn Toggling Time before Release from Deep Power-Down Mode)
      (3) tRDP (Recovery Time for Release from Deep Power-Down Mode)

      Absence of this property indicates that the RDPD command should be
      used to wake the chip from Deep Power-Down mode.

  t-enter-dpd:
    type: int
    description: |
      Duration required to complete the DPD command.

      This provides the duration, in nanoseconds, that CSn must be
      remain deasserted after issuing DPD before the chip will enter
      deep power down.

      If not provided the driver does not enforce a delay.

  t-exit-dpd:
    type: int
    description: |
      Duration required to complete the RDPD command.

      This provides the duration, in nanoseconds, that CSn must be
      remain deasserted after issuing RDPD before the chip will exit
      deep power down and be ready to receive additional commands.

      If not provided the driver does not enforce a delay.

  has-bp:
    type: int
    description: |
      Bit mask of bits of the status register that should be cleared on
      startup.

      Some devices from certain vendors power-up with block protect bits
      set in the status register, which prevent any erase or program
      operation from working.  Devices that have this behavior need to
      clear those bits on startup.  However, other devices have
      non-volatile bits in the status register that should not be
      cleared.

      This value, when present, identifies bits in the status register
      that should be cleared when the device is initialized.
```

## dts/bindings/mtd/mspi-aps256.yaml
```yaml
# Copyright 2024 Ambiq Micro Inc.
# SPDX-License-Identifier: Apache-2.0

description: AP Memory APS256 pSRAM on MSPI bus

compatible: "mspi-aps256"

include: ambiq,mspi-device.yaml
```

## dts/bindings/mtd/mspi-aps256n.yaml
```yaml
# Copyright 2024 Ambiq Micro Inc.
# SPDX-License-Identifier: Apache-2.0

description: AP Memory APS256 pSRAM on MSPI bus

compatible: "mspi-aps256n"

include: [mspi-device.yaml, "jedec,jesd216.yaml"]
```

## dts/bindings/spi/ambiq,ap3-mspi.yaml
```yaml
# Copyright (c) 2023 Antmicro <www.antmicro.com>
# SPDX-License-Identifier: Apache-2.0

description: Ambiq MSPI

compatible: "ambiq,ap3-mspi"

include: [spi-controller.yaml, pinctrl-device.yaml, ambiq-pwrcfg.yaml]

properties:
  reg:
    required: true

  interrupts:
    required: true

  ambiq,pwrcfg:
    required: true

  # lines:
  #   type: int
  #   enum:
  #     - 1
  #     - 2
  #     - 4
  #     - 8



  # ambiq,timing:
  #   type: array
  #   required: true
  #   description: |
  #   Expected fields, in order:
  #   * turnaround
  #   * writeLatency


  # scrambling:
  #   "#address-cells":
  #   required: true
  #   "#size-cells":
  #   required: true

  # dma,set:
```

## dts/bindings/spi/ambiq,mspi.yaml
```yaml
# Copyright (c) 2023 Antmicro <www.antmicro.com>
# SPDX-License-Identifier: Apache-2.0

description: Ambiq MSPI

compatible: "ambiq,mspi"

include: [spi-controller.yaml, pinctrl-device.yaml, ambiq-pwrcfg.yaml]

properties:
  reg:
    required: true

  interrupts:
    required: true

  ambiq,pwrcfg:
    required: true

  mspi-ce:
    type: int
    description: |
      CE number(0-1)
```

## dts/bindings/usb/ambiq,usb.yaml
```yaml
# Copyright (c) 2023 Antmicro <www.antmicro.com>
# SPDX-License-Identifier: Apache-2.0

description: Ambiq USB

compatible: "ambiq,usb"

include: [usb-ep.yaml, pinctrl-device.yaml, ambiq-pwrcfg.yaml]

properties:
  reg:
    required: true

  interrupts:
    required: true

  ram-size:
    type: int
    required: true
    description: |
      Size of USB dedicated RAM.

  ambiq,pwrcfg:
    required: true

  phys:
    type: phandle
    description: PHY provider specifier

  clock-frequency:
    required: true
```

## samples/bluetooth/ble_firmware_update/sample.yaml
```yaml
sample:
  name: BLE Firmware Update
  description: Update the BLE controller firmware
tests:
  sample.bluetooth.ble_firmware_update:
    harness: bluetooth
    platform_allow:
      - apollo4p_blue_kxr_evb
    tags: bluetooth
```

## samples/bluetooth/fcc_test/sample.yaml
```yaml
sample:
  name: Bluetooth FCC Test
tests:
  sample.bluetooth.fcc_test:
    harness: bluetooth
    platform_allow:
      - apollop_blue_kxr_evb
    tags: bluetooth
```

## samples/bluetooth/peripheral_amota/sample.yaml
```yaml
sample:
  name: Bluetooth AMOTA
  description: Demonstrates the Ambiq OTA GATT Service
tests:
  sample.bluetooth.periphral_amota:
    harness: bluetooth
    platform_allow:
      - apollo4p_blue_kxr_evb
    tags: bluetooth
```

## samples/bluetooth/uart_ble_bridge/sample.yaml
```yaml
sample:
  name: UART BLE Bridge
  description: UART BLE Bridge Sample
tests:
  sample.bluetooth.uart_ble_bridge:
    harness: bluetooth
    platform_allow:
      - apollo4p_blue_kxr_evb
    tags:
      - uart
      - bluetooth
```

## subsys/bluetooth/services/Kconfig.amota
```kconfig
#
# Copyright (c) 2023 Ambiq Micro Inc.
#
# SPDX-License-Identifier: Apache-2.0

config BT_AMOTA
	bool "AMOTA service"
	help
	 Enable Ambiq GATT AMOTA BLE service.
```

## subsys/bluetooth/services/Kconfig.ancsc
```kconfig
#
# Copyright (c) 2023 Ambiq Micro Inc.
#

menuconfig BT_ANCSC
	bool "Apple Notification Center Service client"
	help
	  Enable Apple Notification Center Service client.
```

## subsys/bluetooth/services/Kconfig.throughput
```kconfig
# Copyright (c) 2023 Ambiq Micro Inc.

config BT_THROUGHPUT
	bool "Throughput service"
	help
	 Enable Ambiq GATT throughput BLE service.
```

## tests/drivers/i2s/i2s_api/boards/apollo4p_evb.conf
```kconfig
#
# Copyright (c) 2023, Ambiq LLC
#
# SPDX-License-Identifier: Apache-2.0
#

CONFIG_HEAP_MEM_POOL_SIZE=2048
CONFIG_I2S_TEST_SEPARATE_DEVICES=y
CONFIG_NO_OPTIMIZATIONS=y
```
